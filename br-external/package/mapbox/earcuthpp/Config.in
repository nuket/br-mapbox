## br-external/package/mapbox/earcuthpp/Config.in
```kconfig
config BR2_PACKAGE_EARCUTHPP
	bool "earcuthpp"
	default y
	help
	  C++ earcut.hpp Header

	  A C++ port of earcut.js, a fast, header-only polygon triangulation library.

	  The library implements a modified ear slicing algorithm, optimized by z-order 
          curve hashing and extended to handle holes, twisted polygons, degeneracies 
          and self-intersections in a way that doesn't guarantee correctness of 
          triangulation, but attempts to always produce acceptable results for practical 
          data like geographical shapes.

	  https://github.com/mapbox/earcut.hpp
```

## br-external/package/mapbox/mapboxglshaders/Config.in
```kconfig
config BR2_PACKAGE_MAPBOXGLSHADERS
	bool "mapboxglshaders"
	default y
	help
	  This repository contains GL shaders which are shared by Mapbox GL JS and Mapbox GL Native.

	  https://github.com/mapbox/mapbox-gl-shaders
```

## br-external/package/mapbox/uniqueresourcehpp/Config.in
```kconfig
config BR2_PACKAGE_UNIQUERESOURCEHPP
	bool "uniqueresourcehpp"
	default y
	help
	  C++ unique_resource.hpp Header

	  https://github.com/okdshin/unique_resource
```
